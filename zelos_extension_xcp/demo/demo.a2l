/* Demo ECU of the Zelos XCP extension. Generated by zelos_extension_xcp/demo/a2l.py. */ ASAP2_VERSION 1 71
/begin PROJECT demo "Zelos XCP demo ECU"
/begin HEADER "" VERSION "1" /end HEADER
/begin MODULE demo "Demo traction inverter"
/begin MOD_COMMON "" BYTE_ORDER MSB_LAST ALIGNMENT_BYTE 1 ALIGNMENT_WORD 2 ALIGNMENT_LONG 4 ALIGNMENT_INT64 8 ALIGNMENT_FLOAT32_IEEE 4 ALIGNMENT_FLOAT64_IEEE 8 /end MOD_COMMON
/begin MOD_PAR "" EPK "ZELOS_XCP_DEMO_V1" ADDR_EPK 0x80000000 /end MOD_PAR
/begin IF_DATA XCP
 /begin PROTOCOL_LAYER 0x0104 1000 2000 0 0 0 0 0 8 8 BYTE_ORDER_MSB_LAST ADDRESS_GRANULARITY_BYTE OPTIONAL_CMD GET_COMM_MODE_INFO OPTIONAL_CMD GET_ID OPTIONAL_CMD SET_MTA OPTIONAL_CMD UPLOAD OPTIONAL_CMD SHORT_UPLOAD OPTIONAL_CMD GET_DAQ_CLOCK OPTIONAL_CMD GET_DAQ_PROCESSOR_INFO OPTIONAL_CMD GET_DAQ_RESOLUTION_INFO OPTIONAL_CMD GET_DAQ_EVENT_INFO OPTIONAL_CMD GET_DAQ_LIST_MODE OPTIONAL_CMD SET_DAQ_PTR OPTIONAL_CMD WRITE_DAQ OPTIONAL_CMD SET_DAQ_LIST_MODE OPTIONAL_CMD START_STOP_DAQ_LIST OPTIONAL_CMD START_STOP_SYNCH OPTIONAL_CMD FREE_DAQ OPTIONAL_CMD ALLOC_DAQ OPTIONAL_CMD ALLOC_ODT OPTIONAL_CMD ALLOC_ODT_ENTRY /end PROTOCOL_LAYER
 /begin DAQ DYNAMIC 16 2 0 OPTIMISATION_TYPE_DEFAULT ADDRESS_EXTENSION_FREE IDENTIFICATION_FIELD_TYPE_ABSOLUTE GRANULARITY_ODT_ENTRY_SIZE_DAQ_BYTE 7 NO_OVERLOAD_INDICATION /begin TIMESTAMP_SUPPORTED 0x1 SIZE_DWORD UNIT_1US TIMESTAMP_FIXED /end TIMESTAMP_SUPPORTED /begin EVENT "10ms" "10ms" 0x0 DAQ 0xFF 10 6 0 CONSISTENCY EVENT /end EVENT /begin EVENT "100ms" "100ms" 0x1 DAQ 0xFF 100 6 0 CONSISTENCY EVENT /end EVENT /end DAQ
 /begin XCP_ON_CAN 0x0104 CAN_ID_MASTER 0x7F0 CAN_ID_SLAVE 0x7F1 BAUDRATE 500000 MAX_BUS_LOAD 50 MEASUREMENT_SPLIT_ALLOWED
  /begin PROTOCOL_LAYER 0x0104 1000 2000 0 0 0 0 0 8 8 BYTE_ORDER_MSB_LAST ADDRESS_GRANULARITY_BYTE /end PROTOCOL_LAYER
 /end XCP_ON_CAN
 /begin XCP_ON_UDP_IP 0x0104 5555 ADDRESS "127.0.0.1"
  /begin PROTOCOL_LAYER 0x0104 1000 2000 0 0 0 0 0 255 256 BYTE_ORDER_MSB_LAST ADDRESS_GRANULARITY_BYTE /end PROTOCOL_LAYER
  /begin DAQ DYNAMIC 16 2 0 OPTIMISATION_TYPE_DEFAULT ADDRESS_EXTENSION_FREE IDENTIFICATION_FIELD_TYPE_ABSOLUTE GRANULARITY_ODT_ENTRY_SIZE_DAQ_BYTE 255 NO_OVERLOAD_INDICATION /begin TIMESTAMP_SUPPORTED 0x1 SIZE_DWORD UNIT_1US TIMESTAMP_FIXED /end TIMESTAMP_SUPPORTED /begin EVENT "10ms" "10ms" 0x0 DAQ 0xFF 10 6 0 CONSISTENCY EVENT /end EVENT /begin EVENT "100ms" "100ms" 0x1 DAQ 0xFF 100 6 0 CONSISTENCY EVENT /end EVENT /end DAQ
 /end XCP_ON_UDP_IP
 /begin XCP_ON_TCP_IP 0x0104 5555 ADDRESS "127.0.0.1"
  /begin PROTOCOL_LAYER 0x0104 1000 2000 0 0 0 0 0 255 256 BYTE_ORDER_MSB_LAST ADDRESS_GRANULARITY_BYTE /end PROTOCOL_LAYER
  /begin DAQ DYNAMIC 16 2 0 OPTIMISATION_TYPE_DEFAULT ADDRESS_EXTENSION_FREE IDENTIFICATION_FIELD_TYPE_ABSOLUTE GRANULARITY_ODT_ENTRY_SIZE_DAQ_BYTE 255 NO_OVERLOAD_INDICATION /begin TIMESTAMP_SUPPORTED 0x1 SIZE_DWORD UNIT_1US TIMESTAMP_FIXED /end TIMESTAMP_SUPPORTED /begin EVENT "10ms" "10ms" 0x0 DAQ 0xFF 10 6 0 CONSISTENCY EVENT /end EVENT /begin EVENT "100ms" "100ms" 0x1 DAQ 0xFF 100 6 0 CONSISTENCY EVENT /end EVENT /end DAQ
 /end XCP_ON_TCP_IP
/end IF_DATA
/begin COMPU_METHOD conv.state "" TAB_VERB "%.3" "" COMPU_TAB_REF conv.state.table /end COMPU_METHOD
/begin COMPU_VTAB conv.state.table "" TAB_VERB 5 0 "OFF" 1 "PRECHARGE" 2 "READY" 3 "RUN" 4 "FAULT" DEFAULT_VALUE "unknown" /end COMPU_VTAB
/begin COMPU_METHOD conv.rpm_q2 "" LINEAR "%.3" "rpm" COEFFS_LINEAR 0.25 0 /end COMPU_METHOD
/begin COMPU_METHOD conv.angle "" LINEAR "%.3" "deg" COEFFS_LINEAR 0.0054931640625 0 /end COMPU_METHOD
/begin COMPU_METHOD conv.adc_v "" RAT_FUNC "%.3" "V" COEFFS 0 4.095 100 0 0 1 /end COMPU_METHOD
/begin COMPU_METHOD conv.milli_nm "" LINEAR "%.3" "Nm" COEFFS_LINEAR 0.001 0 /end COMPU_METHOD
/begin COMPU_METHOD conv.milli_j "" LINEAR "%.3" "J" COEFFS_LINEAR 0.001 0 /end COMPU_METHOD
/begin COMPU_METHOD conv.half_pct "" LINEAR "%.3" "%" COEFFS_LINEAR 0.5 0 /end COMPU_METHOD
/begin COMPU_METHOD conv.deci_degc "" LINEAR "%.3" "degC" COEFFS_LINEAR 0.1 0 /end COMPU_METHOD
/begin COMPU_METHOD conv.milli_v "" LINEAR "%.3" "V" COEFFS_LINEAR 0.001 0 /end COMPU_METHOD
/begin TYPEDEF_MEASUREMENT temps.igbt "IGBT" SWORD conv.deci_degc 0 0 -40 200 /end TYPEDEF_MEASUREMENT
/begin TYPEDEF_MEASUREMENT temps.diode "Diode" SWORD conv.deci_degc 0 0 -40 200 /end TYPEDEF_MEASUREMENT
/begin TYPEDEF_STRUCTURE temps "" 4 /begin STRUCTURE_COMPONENT igbt temps.igbt 0 /end STRUCTURE_COMPONENT /begin STRUCTURE_COMPONENT diode temps.diode 2 /end STRUCTURE_COMPONENT /end TYPEDEF_STRUCTURE
/begin TYPEDEF_MEASUREMENT phase.current "Current" FLOAT32_IEEE NO_COMPU_METHOD 0 0 -500 500 PHYS_UNIT "A" /end TYPEDEF_MEASUREMENT
/begin TYPEDEF_MEASUREMENT phase.voltage "Voltage" FLOAT32_IEEE NO_COMPU_METHOD 0 0 -500 500 PHYS_UNIT "V" /end TYPEDEF_MEASUREMENT
/begin TYPEDEF_STRUCTURE phase "" 12 /begin STRUCTURE_COMPONENT current phase.current 0 /end STRUCTURE_COMPONENT /begin STRUCTURE_COMPONENT voltage phase.voltage 4 /end STRUCTURE_COMPONENT /begin STRUCTURE_COMPONENT temp temps 8 /end STRUCTURE_COMPONENT /end TYPEDEF_STRUCTURE
/begin MEASUREMENT inv.state "Inverter state" UBYTE conv.state 0 0 0 4 ECU_ADDRESS 0x10000
 /begin IF_DATA XCP
  /begin DAQ_EVENT VARIABLE /begin DEFAULT_EVENT_LIST EVENT 0x0 /end DEFAULT_EVENT_LIST /end DAQ_EVENT
 /end IF_DATA
/end MEASUREMENT
/begin MEASUREMENT inv.dc.flow "DC power flow: 1 out of the battery, -1 into it" SBYTE NO_COMPU_METHOD 0 0 -1 1 ECU_ADDRESS 0x10001
 /begin IF_DATA XCP
  /begin DAQ_EVENT VARIABLE /begin DEFAULT_EVENT_LIST EVENT 0x0 /end DEFAULT_EVENT_LIST /end DAQ_EVENT
 /end IF_DATA
/end MEASUREMENT
/begin MEASUREMENT inv.status_word "Status bits" UWORD NO_COMPU_METHOD 0 0 0 65535 ECU_ADDRESS 0x10002
 /begin IF_DATA XCP
  /begin DAQ_EVENT VARIABLE /begin DEFAULT_EVENT_LIST EVENT 0x0 /end DEFAULT_EVENT_LIST /end DAQ_EVENT
 /end IF_DATA
/end MEASUREMENT
/begin MEASUREMENT inv.flag.precharged "Precharge done" UWORD NO_COMPU_METHOD 0 0 0 1 ECU_ADDRESS 0x10002 BIT_MASK 0x1
 /begin IF_DATA XCP
  /begin DAQ_EVENT VARIABLE /begin DEFAULT_EVENT_LIST EVENT 0x0 /end DEFAULT_EVENT_LIST /end DAQ_EVENT
 /end IF_DATA
/end MEASUREMENT
/begin MEASUREMENT inv.flag.running "State RUN" UWORD NO_COMPU_METHOD 0 0 0 1 ECU_ADDRESS 0x10002 BIT_MASK 0x2
 /begin IF_DATA XCP
  /begin DAQ_EVENT VARIABLE /begin DEFAULT_EVENT_LIST EVENT 0x0 /end DEFAULT_EVENT_LIST /end DAQ_EVENT
 /end IF_DATA
/end MEASUREMENT
/begin MEASUREMENT inv.flag.derate "IGBT over 55 degC" UWORD NO_COMPU_METHOD 0 0 0 1 ECU_ADDRESS 0x10002 BIT_MASK 0x4
 /begin IF_DATA XCP
  /begin DAQ_EVENT VARIABLE /begin DEFAULT_EVENT_LIST EVENT 0x0 /end DEFAULT_EVENT_LIST /end DAQ_EVENT
 /end IF_DATA
/end MEASUREMENT
/begin MEASUREMENT inv.flag.toggle "Toggles every 10 ms" UWORD NO_COMPU_METHOD 0 0 0 1 ECU_ADDRESS 0x10002 BIT_MASK 0x8000
 /begin IF_DATA XCP
  /begin DAQ_EVENT VARIABLE /begin DEFAULT_EVENT_LIST EVENT 0x0 /end DEFAULT_EVENT_LIST /end DAQ_EVENT
 /end IF_DATA
/end MEASUREMENT
/begin MEASUREMENT motor.speed "Speed" SWORD conv.rpm_q2 0 0 -8000 8000 ECU_ADDRESS 0x10004
 /begin IF_DATA XCP
  /begin DAQ_EVENT VARIABLE /begin DEFAULT_EVENT_LIST EVENT 0x0 /end DEFAULT_EVENT_LIST /end DAQ_EVENT
 /end IF_DATA
/end MEASUREMENT
/begin MEASUREMENT motor.angle "Electrical angle" UWORD conv.angle 0 0 0 360 ECU_ADDRESS 0x10006
 /begin IF_DATA XCP
  /begin DAQ_EVENT VARIABLE /begin DEFAULT_EVENT_LIST EVENT 0x0 /end DEFAULT_EVENT_LIST /end DAQ_EVENT
 /end IF_DATA
/end MEASUREMENT
/begin MEASUREMENT inv.dc.voltage_adc "DC bus ADC" UWORD conv.adc_v 0 0 0 975 ECU_ADDRESS 0x10008
 /begin IF_DATA XCP
  /begin DAQ_EVENT VARIABLE /begin DEFAULT_EVENT_LIST EVENT 0x0 /end DEFAULT_EVENT_LIST /end DAQ_EVENT
 /end IF_DATA
/end MEASUREMENT
/begin MEASUREMENT motor.torque "Torque" FLOAT32_IEEE NO_COMPU_METHOD 0 0 -300 300 ECU_ADDRESS 0x1000C PHYS_UNIT "Nm"
 /begin IF_DATA XCP
  /begin DAQ_EVENT VARIABLE /begin DEFAULT_EVENT_LIST EVENT 0x0 /end DEFAULT_EVENT_LIST /end DAQ_EVENT
 /end IF_DATA
/end MEASUREMENT
/begin MEASUREMENT motor.torque_cmd "Torque command" SLONG conv.milli_nm 0 0 -300 300 ECU_ADDRESS 0x10010
 /begin IF_DATA XCP
  /begin DAQ_EVENT VARIABLE /begin DEFAULT_EVENT_LIST EVENT 0x0 /end DEFAULT_EVENT_LIST /end DAQ_EVENT
 /end IF_DATA
/end MEASUREMENT
/begin MEASUREMENT motor.ctrl.id_ref "d current" FLOAT32_IEEE NO_COMPU_METHOD 0 0 -500 500 ECU_ADDRESS 0x10014 PHYS_UNIT "A"
 /begin IF_DATA XCP
  /begin DAQ_EVENT VARIABLE /begin DEFAULT_EVENT_LIST EVENT 0x0 /end DEFAULT_EVENT_LIST /end DAQ_EVENT
 /end IF_DATA
/end MEASUREMENT
/begin MEASUREMENT motor.ctrl.iq_ref "q current" FLOAT32_IEEE NO_COMPU_METHOD 0 0 -500 500 ECU_ADDRESS 0x10018 PHYS_UNIT "A"
 /begin IF_DATA XCP
  /begin DAQ_EVENT VARIABLE /begin DEFAULT_EVENT_LIST EVENT 0x0 /end DEFAULT_EVENT_LIST /end DAQ_EVENT
 /end IF_DATA
/end MEASUREMENT
/begin MEASUREMENT inv.dc.voltage "DC bus" FLOAT32_IEEE NO_COMPU_METHOD 0 0 0 1000 ECU_ADDRESS 0x1001C PHYS_UNIT "V"
 /begin IF_DATA XCP
  /begin DAQ_EVENT VARIABLE /begin DEFAULT_EVENT_LIST EVENT 0x0 /end DEFAULT_EVENT_LIST /end DAQ_EVENT
 /end IF_DATA
/end MEASUREMENT
/begin MEASUREMENT inv.dc.current "DC current" FLOAT32_IEEE NO_COMPU_METHOD 0 0 -1000 1000 ECU_ADDRESS 0x10020 PHYS_UNIT "A"
 /begin IF_DATA XCP
  /begin DAQ_EVENT VARIABLE /begin DEFAULT_EVENT_LIST EVENT 0x0 /end DEFAULT_EVENT_LIST /end DAQ_EVENT
 /end IF_DATA
/end MEASUREMENT
/begin MEASUREMENT sys.tick_10ms "10 ms task runs" ULONG NO_COMPU_METHOD 0 0 0 4294967295 ECU_ADDRESS 0x10024
 /begin IF_DATA XCP
  /begin DAQ_EVENT VARIABLE /begin DEFAULT_EVENT_LIST EVENT 0x0 /end DEFAULT_EVENT_LIST /end DAQ_EVENT
 /end IF_DATA
/end MEASUREMENT
/begin MEASUREMENT inv.dc.power "DC power" FLOAT64_IEEE NO_COMPU_METHOD 0 0 -500000 500000 ECU_ADDRESS 0x10028 PHYS_UNIT "W"
 /begin IF_DATA XCP
  /begin DAQ_EVENT VARIABLE /begin DEFAULT_EVENT_LIST EVENT 0x0 /end DEFAULT_EVENT_LIST /end DAQ_EVENT
 /end IF_DATA
/end MEASUREMENT
/begin MEASUREMENT motor.omega "Speed" FLOAT64_IEEE NO_COMPU_METHOD 0 0 -1000 1000 ECU_ADDRESS 0x10030 PHYS_UNIT "rad/s"
 /begin IF_DATA XCP
  /begin DAQ_EVENT VARIABLE /begin DEFAULT_EVENT_LIST EVENT 0x0 /end DEFAULT_EVENT_LIST /end DAQ_EVENT
 /end IF_DATA
/end MEASUREMENT
/begin MEASUREMENT sys.uptime_ns "Time of this task run" A_UINT64 NO_COMPU_METHOD 0 0 0 1.8e+19 ECU_ADDRESS 0x10038 PHYS_UNIT "ns"
 /begin IF_DATA XCP
  /begin DAQ_EVENT VARIABLE /begin DEFAULT_EVENT_LIST EVENT 0x0 /end DEFAULT_EVENT_LIST /end DAQ_EVENT
 /end IF_DATA
/end MEASUREMENT
/begin MEASUREMENT sys.energy "DC energy" A_INT64 conv.milli_j 0 0 -1000000000000 1000000000000 ECU_ADDRESS 0x10040
 /begin IF_DATA XCP
  /begin DAQ_EVENT VARIABLE /begin DEFAULT_EVENT_LIST EVENT 0x0 /end DEFAULT_EVENT_LIST /end DAQ_EVENT
 /end IF_DATA
/end MEASUREMENT
/begin INSTANCE motor.phase "Phase U, V, W" phase 0x10048 MATRIX_DIM 3
 /begin IF_DATA XCP
  /begin DAQ_EVENT VARIABLE /begin DEFAULT_EVENT_LIST EVENT 0x0 /end DEFAULT_EVENT_LIST /end DAQ_EVENT
 /end IF_DATA
/end INSTANCE
/begin MEASUREMENT bms.soc "State of charge" UBYTE conv.half_pct 0 0 0 100 ECU_ADDRESS 0x11000
 /begin IF_DATA XCP
  /begin DAQ_EVENT VARIABLE /begin DEFAULT_EVENT_LIST EVENT 0x1 /end DEFAULT_EVENT_LIST /end DAQ_EVENT
 /end IF_DATA
/end MEASUREMENT
/begin MEASUREMENT cooling.coolant_temp "Coolant" SWORD conv.deci_degc 0 0 -40 200 ECU_ADDRESS 0x11002
 /begin IF_DATA XCP
  /begin DAQ_EVENT VARIABLE /begin DEFAULT_EVENT_LIST EVENT 0x1 /end DEFAULT_EVENT_LIST /end DAQ_EVENT
 /end IF_DATA
/end MEASUREMENT
/begin MEASUREMENT cooling.pump_speed "Pump" UWORD NO_COMPU_METHOD 0 0 0 6000 ECU_ADDRESS 0x11004 PHYS_UNIT "rpm"
 /begin IF_DATA XCP
  /begin DAQ_EVENT VARIABLE /begin DEFAULT_EVENT_LIST EVENT 0x1 /end DEFAULT_EVENT_LIST /end DAQ_EVENT
 /end IF_DATA
/end MEASUREMENT
/begin MEASUREMENT bms.cell_voltage "Cell voltages" UWORD conv.milli_v 0 0 0 5 ECU_ADDRESS 0x11006 MATRIX_DIM 96
 /begin IF_DATA XCP
  /begin DAQ_EVENT VARIABLE /begin DEFAULT_EVENT_LIST EVENT 0x1 /end DEFAULT_EVENT_LIST /end DAQ_EVENT
 /end IF_DATA
/end MEASUREMENT
/begin MEASUREMENT diag.heartbeat "100 ms counter" UBYTE NO_COMPU_METHOD 0 0 0 255 ECU_ADDRESS 0x10000 ECU_ADDRESS_EXTENSION 1
 /begin IF_DATA XCP
  /begin DAQ_EVENT VARIABLE /begin DEFAULT_EVENT_LIST EVENT 0x1 /end DEFAULT_EVENT_LIST /end DAQ_EVENT
 /end IF_DATA
/end MEASUREMENT
/begin MEASUREMENT diag.cpu_load "CPU load" FLOAT32_IEEE NO_COMPU_METHOD 0 0 0 100 ECU_ADDRESS 0x10004 ECU_ADDRESS_EXTENSION 1 PHYS_UNIT "%"
 /begin IF_DATA XCP
  /begin DAQ_EVENT VARIABLE /begin DEFAULT_EVENT_LIST EVENT 0x1 /end DEFAULT_EVENT_LIST /end DAQ_EVENT
 /end IF_DATA
/end MEASUREMENT
/begin MEASUREMENT diag.signature "Constant" ULONG NO_COMPU_METHOD 0 0 0 4294967295 ECU_ADDRESS 0x10008 ECU_ADDRESS_EXTENSION 1
 /begin IF_DATA XCP
  /begin DAQ_EVENT VARIABLE /begin DEFAULT_EVENT_LIST EVENT 0x1 /end DEFAULT_EVENT_LIST /end DAQ_EVENT
 /end IF_DATA
/end MEASUREMENT
/begin MEASUREMENT sys.build "Build number" ULONG NO_COMPU_METHOD 0 0 0 4294967295 ECU_ADDRESS 0x12000 /end MEASUREMENT
/end MODULE
/end PROJECT
